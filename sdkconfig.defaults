## sdkconfig.defaults
```kconfig
CONFIG_IDF_TARGET="esp32s3"

CONFIG_ESPTOOLPY_FLASHSIZE_16MB=y
CONFIG_ESPTOOLPY_FLASHMODE_QIO=y
CONFIG_ESPTOOLPY_FLASHFREQ_80M=y
CONFIG_ESP_DEFAULT_CPU_FREQ_MHZ_240=y

CONFIG_SPIRAM=y
CONFIG_SPIRAM_MODE_OCT=y
CONFIG_SPIRAM_SPEED_80M=y
CONFIG_SPIRAM_XIP_FROM_PSRAM=y
CONFIG_SPIRAM_MEMTEST=n

CONFIG_PARTITION_TABLE_CUSTOM=y
CONFIG_PARTITION_TABLE_CUSTOM_FILENAME="partitions.csv"
CONFIG_PARTITION_TABLE_OFFSET=0x8000

CONFIG_FREERTOS_HZ=1000
CONFIG_ESP_MAIN_TASK_STACK_SIZE=8192
CONFIG_ESP_SYSTEM_EVENT_TASK_STACK_SIZE=4096

# Console/debug shell over the USB-Serial-JTAG port (COM9 on this board).
CONFIG_ESP_CONSOLE_USB_SERIAL_JTAG=y
CONFIG_ESP_CONSOLE_SECONDARY_NONE=y
CONFIG_FREERTOS_USE_TRACE_FACILITY=y
CONFIG_FREERTOS_USE_STATS_FORMATTING_FUNCTIONS=y
CONFIG_FREERTOS_GENERATE_RUN_TIME_STATS=y
CONFIG_FREERTOS_VTASKLIST_INCLUDE_COREID=y

# Core dump to the dedicated flash partition.
CONFIG_ESP_COREDUMP_ENABLE_TO_FLASH=y
CONFIG_ESP_COREDUMP_USE_STACK_SIZE=y
CONFIG_ESP_COREDUMP_STACK_SIZE=2048
CONFIG_ESP_COREDUMP_MAX_TASKS_NUM=32
CONFIG_ESP_COREDUMP_CAPTURE_DRAM=n

CONFIG_LV_COLOR_DEPTH_24=y
CONFIG_LV_USE_CLIB_MALLOC=y
CONFIG_LV_USE_CLIB_STRING=y
CONFIG_LV_USE_CLIB_SPRINTF=y
CONFIG_LV_OS_FREERTOS=y
CONFIG_LV_DEF_REFR_PERIOD=15
CONFIG_LV_DRAW_SW_DRAW_UNIT_CNT=2
CONFIG_LV_DRAW_LAYER_SIMPLE_BUF_SIZE=32000
CONFIG_LV_DRAW_THREAD_PRIO=4
CONFIG_LV_DRAW_THREAD_STACK_SIZE=8192
CONFIG_LV_GRADIENT_MAX_STOPS=4
CONFIG_LV_OBJ_STYLE_CACHE=y
# CONFIG_LV_USE_SYSMON is not set

CONFIG_FATFS_LFN_HEAP=y
CONFIG_FATFS_MAX_LFN=255
CONFIG_FATFS_API_ENCODING_UTF_8=y

CONFIG_ESPAUDIOCORE_ENABLE_MP3=y
CONFIG_ESPAUDIOCORE_ENABLE_FLAC=y
CONFIG_ESPAUDIOCORE_ENABLE_WAV=y
CONFIG_ESPAUDIOCORE_ENABLE_AAC=y
CONFIG_ESPAUDIOCORE_ENABLE_M4A=y
CONFIG_ESPAUDIOCORE_ENABLE_VORBIS=y
CONFIG_ESPAUDIOCORE_ENABLE_OPUS=y
CONFIG_ESPAUDIOCORE_ENABLE_WAVPACK=y
CONFIG_LV_FONT_MONTSERRAT_28=y
CONFIG_ESPAUDIOCORE_OUTPUT_BITS=32
CONFIG_ESPAUDIOCORE_TASK_STACK_DEFAULT=12288
CONFIG_ESPAUDIOCORE_TASK_PRIORITY=12
CONFIG_ESPAUDIOCORE_TASK_CORE=0

# Audio decode owns core 0; keep esp_timer (prio 22) and its ISR off that core.
CONFIG_ESP_TIMER_SHOW_EXPERIMENTAL=y
CONFIG_ESP_TIMER_TASK_AFFINITY=0x1
# CONFIG_ESP_TIMER_TASK_AFFINITY_CPU0 is not set
CONFIG_ESP_TIMER_TASK_AFFINITY_CPU1=y
# CONFIG_ESP_TIMER_ISR_AFFINITY_CPU0 is not set
CONFIG_ESP_TIMER_ISR_AFFINITY_CPU1=y
CONFIG_ESPAUDIOCORE_FILE_SOURCE_POSIX=y
CONFIG_ESPAUDIOCORE_SOURCE_BUFFER_SIZE=32768

CONFIG_LOG_COLORS=y
CONFIG_BOOTLOADER_LOG_COLORS=y

CONFIG_LV_FONT_MONTSERRAT_12=y
CONFIG_LV_FONT_MONTSERRAT_16=y
CONFIG_LV_FONT_MONTSERRAT_20=y
CONFIG_LV_FONT_MONTSERRAT_24=y

# CONFIG_LV_USE_PERF_MONITOR is not set
CONFIG_LV_FONT_SOURCE_HAN_SANS_SC_16_CJK=y
CONFIG_ESP_LVGL_ADAPTER_ENABLE_FPS_STATS=y



CONFIG_SPIRAM_MALLOC_ALWAYSINTERNAL=1024

CONFIG_LV_USE_TJPGD=y
CONFIG_LV_USE_FS_POSIX=y
CONFIG_LV_FS_POSIX_LETTER=83
CONFIG_LV_FS_POSIX_PATH=""
CONFIG_LV_FS_POSIX_CACHE_SIZE=0

# CONFIG_LV_USE_FS_MEMFS is not set
# CONFIG_LV_FS_MEMFS_LETTER is not set


CONFIG_ESP_MAIN_TASK_STACK_SIZE=12288


CONFIG_LV_USE_MATRIX=y
```
